## BLE/build_1/Kconfig/Kconfig.shield
```kconfig
osource "e:/projects/developmentlevelcode/nrfboard/boards/shields/*/Kconfig.shield"
osource "C:/ncs/v3.2.1/nrf/boards/shields/*/Kconfig.shield"
```

## BLE/build_1/Kconfig/Kconfig.shield.defconfig
```kconfig
osource "e:/projects/developmentlevelcode/nrfboard/boards/shields/*/Kconfig.defconfig"
osource "C:/ncs/v3.2.1/nrf/boards/shields/*/Kconfig.defconfig"
```

## BLE/build_1/Kconfig/boards/Kconfig.WrieLessPotentialDetector_Nrf52832
```kconfig
# Load board Kconfig descriptions.
osource "E:/projects/DevelopmentLevelCode/NRFBOARD/boards/Fervid/WrieLessPotentialDetector_Nrf52832/Kconfig.WrieLessPotentialDetector_Nrf52832"
```

## RSMADC/build_1/Kconfig/boards/Kconfig
```kconfig
# Load Zephyr board Kconfig descriptions.
osource "E:/projects/DevelopmentLevelCode/NRFBOARD/boards/Fervid/WrieLessPotentialDetector_Nrf52832/Kconfig"
```

## RSMADC/build_1/Kconfig/boards/Kconfig.defconfig
```kconfig
# Load Zephyr board defconfig descriptions.
osource "E:/projects/DevelopmentLevelCode/NRFBOARD/boards/Fervid/WrieLessPotentialDetector_Nrf52832/Kconfig.defconfig"
```

## RSMADC/build_1/Kconfig/boards/Kconfig.sysbuild
```kconfig
# Load Sysbuild board Kconfig descriptions.
osource "E:/projects/DevelopmentLevelCode/NRFBOARD/boards/Fervid/WrieLessPotentialDetector_Nrf52832/Kconfig.sysbuild"
```
