## CMakeLists.txt
```
cmake_minimum_required(VERSION 3.20.0)
find_package(Zephyr REQUIRED HINTS $ENV{ZEPHYR_BASE})

project(ACDetector)

target_sources(app PRIVATE 
    src/main.c
    src/adc_lib/adc_backend.c
    src/ble_lib/ble_backend.c
    src/range_lib/range_backend.c
    src/storage_lib/storage_backend.c
)

# Link against MCUboot bootutil library to find headers
zephyr_library_link_libraries(MCUBOOT_BOOTUTIL)
```

## sysbuild.conf
```
# Enable MCUboot bootloader building in sysbuild
SB_CONFIG_BOOTLOADER_MCUBOOT=y
```

## prj.conf
```kconfig
# --- Core ---
CONFIG_MAIN_STACK_SIZE=2048
CONFIG_SYSTEM_WORKQUEUE_STACK_SIZE=2048


# --- UART ---
CONFIG_SERIAL=y
CONFIG_CONSOLE=y
CONFIG_PRINTK=y
CONFIG_PRINTK_SYNC=y
CONFIG_LOG_PRINTK=n

CONFIG_LOG=y
CONFIG_LOG_MODE_DEFERRED=y
CONFIG_LOG_BACKEND_UART=y

# --- Debug ---
CONFIG_THREAD_NAME=y
CONFIG_THREAD_STACK_INFO=y

# --- Bluetooth ---
CONFIG_BT=y
CONFIG_BT_PERIPHERAL=y
CONFIG_BT_DEVICE_NAME="AC_DETECTOR"
CONFIG_BT_SETTINGS=y
CONFIG_BT_BONDABLE=y
CONFIG_BT_ID_MAX=1
CONFIG_BT_SETTINGS_CCC_STORE_ON_WRITE=y

# --- ADC ---
CONFIG_ADC=y
CONFIG_NRFX_SAADC=y

CONFIG_BT_GATT_CLIENT=n
CONFIG_BT_GATT_AUTO_UPDATE_MTU=y
CONFIG_BT_L2CAP_DYNAMIC_CHANNEL=y
CONFIG_BT_GATT_SERVICE_CHANGED=y

# --- Buffers (Safety Focused) ---
CONFIG_BT_BUF_EVT_RX_COUNT=16
CONFIG_BT_BUF_EVT_DISCARDABLE_COUNT=15
CONFIG_BT_BUF_ACL_RX_COUNT_EXTRA=4
CONFIG_BT_BUF_ACL_TX_COUNT=5
CONFIG_BT_L2CAP_TX_BUF_COUNT=10
CONFIG_BT_ATT_TX_COUNT=5
CONFIG_BT_CONN_TX_MAX=10
CONFIG_BT_CTLR_SDC_TX_PACKET_COUNT=5
CONFIG_BT_CTLR_SDC_RX_PACKET_COUNT=5
CONFIG_BT_ATT_PREPARE_COUNT=2
CONFIG_BT_RX_STACK_SIZE=1536

# --- Native GAP Parameter Management (Apple Compliant) ---
CONFIG_BT_PERIPHERAL_PREF_MIN_INT=24
CONFIG_BT_PERIPHERAL_PREF_MAX_INT=40
CONFIG_BT_PERIPHERAL_PREF_LATENCY=0
CONFIG_BT_PERIPHERAL_PREF_TIMEOUT=400
CONFIG_BT_GAP_AUTO_UPDATE_CONN_PARAMS=y

# --- Storage ---
CONFIG_FLASH=y
CONFIG_NVS=y
CONFIG_SETTINGS=y
CONFIG_SETTINGS_NVS=y

# --- MCUmgr DFU ---
CONFIG_BOOTLOADER_MCUBOOT=y
CONFIG_MCUBOOT_BOOTUTIL_LIB=y
CONFIG_MCUMGR=y
CONFIG_STREAM_FLASH=y
CONFIG_FLASH_MAP=y
CONFIG_FLASH=y
CONFIG_IMG_MANAGER=y
CONFIG_MCUMGR_TRANSPORT_BT=y
CONFIG_MCUMGR_GRP_IMG=y
CONFIG_MCUMGR_GRP_OS=y
CONFIG_MCUMGR_TRANSPORT_NETBUF_COUNT=4
CONFIG_MCUMGR_TRANSPORT_NETBUF_SIZE=512
CONFIG_MCUBOOT_IMG_MANAGER=y
CONFIG_MCUMGR_TRANSPORT_BT_PERM_RW=y
CONFIG_MCUMGR_TRANSPORT_BT_REASSEMBLY=y

# Bluetooth dependencies for DFU
CONFIG_BT_L2CAP_DYNAMIC_CHANNEL=y
CONFIG_BT_SMP=y
CONFIG_BT_L2CAP_TX_MTU=247
CONFIG_BT_BUF_ACL_RX_SIZE=251
CONFIG_BT_BUF_ACL_TX_SIZE=251
CONFIG_BT_CTLR_DATA_LENGTH_MAX=251

# DFU Security (Fix for "Authentication Is Insufficient" on iOS)
# CONFIG_MCUMGR_TRANSPORT_BT_PERM_RW=y
# CONFIG_MCUMGR_TRANSPORT_BT_CONN_PARAM_CONTROL is disabled to favor app-level control

CONFIG_ZCBOR=y
CONFIG_CRC=y
CONFIG_NET_BUF=y
CONFIG_STREAM_FLASH=y
```

## src/main.c
```c
#include <zephyr/dfu/mcuboot.h>
#include <zephyr/kernel.h>
#include <zephyr/mgmt/mcumgr/grp/img_mgmt/img_mgmt.h>
#include <zephyr/mgmt/mcumgr/grp/os_mgmt/os_mgmt.h>
#include <zephyr/mgmt/mcumgr/transport/smp_bt.h>
#include <zephyr/sys/printk.h>

#include "adc_lib/adc_backend.h"
#include "ble_lib/ble_backend.h"
#include "range_lib/range_backend.h"
#include "storage_lib/storage_backend.h"

/* Define threads here to ensure they are created at boot */
K_THREAD_DEFINE(ble_thread_id, 2048, ble_tx_thread_fn, NULL, NULL, NULL, 9, 0,
                0);
K_THREAD_DEFINE(adc_thread, 3072, adc_thread_fn, NULL, NULL, NULL, 8, 0, 0);

K_SEM_DEFINE(boot_done_sem, 0, 10);

int main(void) {
  /* Confirm the image immediately to prevent MCUboot from reverting */
  int err = boot_write_img_confirmed();
  if (err) {
    printk("Failed to confirm image: %d\n", err);
  } else {
    printk("Image successfully confirmed.\n");
  }

  printk("\n\t\t>> ACDetector V1.3.0 (IEC 61243-1 Kelvin Verified) <<\n\n");

  /* Initialize Peripherals */
  storage_init(&g_thresholds);
  adc_param_init();
  ble_param_init();
  range_param_init();

  /* Comprehensive Boot Self-Test (Buzzer, Red LED U5, Blue LED U8) */
  annunciation_boot_selftest();

  /* 
   * NOTE: The Power-On Boot Kelvin Self-Test is executed inside adc_thread_fn
   * after boot_done_sem is given, ensuring analog rails and MCP601 virtual ground
   * have settled (100 ms) and running on the thread's private stack to prevent
   * any cold-boot stack collisions or MCUboot test-swap delays.
   */

  printk("ACDetector Initialized. Releasing threads.\n");
  k_sem_give(&boot_done_sem); // Wakes ADC Thread
  k_sem_give(&boot_done_sem); // Wakes BLE Thread

  /* Main loop */
  while (1) {
    k_sleep(K_MSEC(1000));
  }
  return 0;
}
```

## src/common.h
```c
#ifndef COMMON_H
#define COMMON_H

#include <stdbool.h>
#include <stdint.h>

/* ================= Data Micro ================= */
#define SAMPLE_COUNT 200
#define ADC_PERIOD_MS 10
#define ADC_AVG_COUNT 8
#define SAMPLES_PER_PKT 8
#define ADC_LSB_uV 879
// Calibrated ratio for 1M + 300k divider (8830mV output target): 1308 / 300
#define BATTERY_SCALE_MUL 1308
#define BATTERY_SCALE_DIV 300

/* ================= Data Enum ================= */
enum pkt_type {
  PKT_BLC = 1,
  PKT_ALC = 2,
  PKT_STATS_1 = 4,
  PKT_STATS_2 = 5,
  PKT_RET_SETTINGS_1 = 6,
  PKT_RET_SETTINGS_2 = 7,
  PKT_END = 0xFF
};

/* ================= Data Struct ================= */
typedef struct {
  int32_t blc_mean_min;
  int32_t blc_mean_max;
  int32_t blc_rms_min;
  int32_t blc_rms_max;

  int32_t alc_mean_min;
  int32_t alc_mean_max;
  int32_t alc_rms_min;
  int32_t alc_rms_max;
} channel_thresholds_t;

typedef struct {
  channel_thresholds_t channels[16];
} thresholds_t;

/* ================= Line Detector Status Enum ================= */
#define STATUS_SAFE 0
#define STATUS_LIVE 1
#define STATUS_INDUCED 2
#define STATUS_FAULT 3

typedef struct {
  int32_t blc_mean_mv;
  int32_t blc_rms_mv;
  int32_t alc_mean_mv;
  int32_t alc_rms_mv;
  int32_t battery_mv;
  int32_t induced_voltage_mv;
  uint8_t battery_percent;
  uint8_t Line_detector_Status;
  uint8_t selected_range;
} data_t;

/* ================= Packet Structs ================= */
typedef struct __packed {
  uint8_t type;         // BLC / ALC / BAT / END
  uint8_t count;        // number of samples
  uint16_t start_index; // sample index
  int16_t samples[SAMPLES_PER_PKT];
} Data_packet;

// Packet 1: Status + Battery + BLC (16 bytes)
typedef struct __packed {
  uint8_t type; // PKT_STATS_1
  uint8_t Line_detector_Status;
  uint8_t battery_percent;
  uint8_t reserved;

  int32_t battery_mv;
  int32_t blc_mean_mV;
  int32_t blc_rms_mV;
} Stats_packet_1;

// Packet 2: ALC (9 bytes)
typedef struct __packed {
  uint8_t type; // PKT_STATS_2
  int32_t alc_mean_mV;
  int32_t alc_rms_mV;
  uint8_t selected_range;
} Stats_packet_2;

// Packet to return Settings Part 1 (BLC)
typedef struct __packed {
  uint8_t type; // PKT_RET_SETTINGS_1
  uint8_t channel_index;
  int32_t blc_mean_min;
  int32_t blc_mean_max;
  int32_t blc_rms_min;
  int32_t blc_rms_max; // Total 1+1+16 = 18 bytes
} Ret_Settings_packet_1;

// Packet to return Settings Part 2 (ALC)
typedef struct __packed {
  uint8_t type; // PKT_RET_SETTINGS_2
  uint8_t channel_index;
  int32_t alc_mean_min;
  int32_t alc_mean_max;
  int32_t alc_rms_min;
  int32_t alc_rms_max; // Total 1+1+16 = 18 bytes
} Ret_Settings_packet_2;

#endif // COMMON_H
```
