## CMakeLists.txt
```
cmake_minimum_required(VERSION 3.20.0)
find_package(Zephyr REQUIRED HINTS $ENV{ZEPHYR_BASE})

project(HC4067intterface)

target_sources(app PRIVATE src/main.c src/hc4067.c)
```

## prj.conf
```kconfig
CONFIG_GPIO=y
CONFIG_SERIAL=y
CONFIG_CONSOLE=y
CONFIG_UART_CONSOLE=y
```

## src/main.c
```c
/*
 * Copyright (c) 2016 Intel Corporation
 *
 * SPDX-License-Identifier: Apache-2.0
 */

#include "hc4067.h"
#include <stdint.h>
#include <zephyr/kernel.h>
#include <zephyr/sys/printk.h>

int main(void) {
  int ret;

  printk("HC4067 Control + UART Example\n");

  ret = hc4067_init();
  if (ret < 0) {
    printk("Failed to initialize HC4067 library (err %d)\n", ret);
    return 0;
  }

  printk("HC4067 Initialized\n");

  while (1) {
    for (uint8_t i = 0; i < 16; i++) {
      hc4067_set_channel(i);
      printk("Channel set to %d\n", i);
      k_msleep(10000);
    }
  }
  return 0;
}
```

## src/hc4067.c
```c
/*
 * hc4067.c - Library for HC4067 Multiplexer
 */

#include "hc4067.h"
#include <zephyr/drivers/gpio.h>

/* The devicetree node identifier for the "range_selIC" alias. */
#define RANGE_SEL_IC0_NODE DT_NODELABEL(range_selic0)
#define RANGE_SEL_IC1_NODE DT_NODELABEL(range_selic1)
#define RANGE_SEL_IC2_NODE DT_NODELABEL(range_selic2)
#define RANGE_SEL_IC3_NODE DT_NODELABEL(range_selic3)

static const struct gpio_dt_spec s0 = GPIO_DT_SPEC_GET(RANGE_SEL_IC0_NODE, gpios);
static const struct gpio_dt_spec s1 = GPIO_DT_SPEC_GET(RANGE_SEL_IC1_NODE, gpios);
static const struct gpio_dt_spec s2 = GPIO_DT_SPEC_GET(RANGE_SEL_IC2_NODE, gpios);
static const struct gpio_dt_spec s3 = GPIO_DT_SPEC_GET(RANGE_SEL_IC3_NODE, gpios);

int hc4067_init(void)
{
	int ret;

	if (!gpio_is_ready_dt(&s0) || !gpio_is_ready_dt(&s1) ||
	    !gpio_is_ready_dt(&s2) || !gpio_is_ready_dt(&s3)) {
		return -ENODEV;
	}

	ret = gpio_pin_configure_dt(&s0, GPIO_OUTPUT_INACTIVE);
	if (ret < 0) return ret;

	ret = gpio_pin_configure_dt(&s1, GPIO_OUTPUT_INACTIVE);
	if (ret < 0) return ret;

	ret = gpio_pin_configure_dt(&s2, GPIO_OUTPUT_INACTIVE);
	if (ret < 0) return ret;

	ret = gpio_pin_configure_dt(&s3, GPIO_OUTPUT_INACTIVE);
	if (ret < 0) return ret;

	return 0;
}

void hc4067_set_channel(uint8_t channel)
{
	gpio_pin_set_dt(&s0, (channel & 0x01) ? 1 : 0);
	gpio_pin_set_dt(&s1, (channel & 0x02) ? 1 : 0);
	gpio_pin_set_dt(&s2, (channel & 0x04) ? 1 : 0);
	gpio_pin_set_dt(&s3, (channel & 0x08) ? 1 : 0);
}
```

## src/hc4067.h
```c
/*
 * hc4067.h - Library for HC4067 Multiplexer
 */

#ifndef HC4067_H
#define HC4067_H

#include <zephyr/kernel.h>
#include <stdint.h>

/**
 * @brief Initialize the HC4067 GPIOs.
 *
 * @return 0 on success, negative errno code on failure.
 */
int hc4067_init(void);

/**
 * @brief Set the HC4067 multiplexer channel.
 *
 * @param channel The channel index (0-15).
 */
void hc4067_set_channel(uint8_t channel);

#endif /* HC4067_H */
```
